## ESP32-C6-LCD-1.47-Demo/ESP-IDF/ESP32-C6-LCD-1.47-Test/sdkconfig.defaults
```kconfig
CONFIG_LV_USE_USER_DATA=y
CONFIG_LV_USE_CHART=y
# CONFIG_LV_USE_PERF_MONITOR is not set
CONFIG_LV_DISP_DEF_REFR_PERIOD=200
CONFIG_ESP_DEFAULT_CPU_FREQ_MHZ_240=y
CONFIG_LV_FONT_MONTSERRAT_8=y
CONFIG_LV_FONT_MONTSERRAT_10=y
CONFIG_LV_FONT_FMT_TXT_LARGE=y
CONFIG_LV_FONT_MONTSERRAT_48=y

CONFIG_BT_ENABLED=y
CONFIG_BT_BLUEDROID_ENABLED=y
CONFIG_BT_CLASSIC_ENABLED=y
CONFIG_BT_A2DP_ENABLE=y
CONFIG_BTDM_CTRL_MODE_BR_EDR_ONLY=y
# CONFIG_BT_BLE_ENABLED is not set
# CONFIG_BTDM_CTRL_MODE_BLE_ONLY is not set
# CONFIG_BT_BLE_50_FEATURES_SUPPORTED is not set
# CONFIG_BT_BLE_42_FEATURES_SUPPORTED is not set

CONFIG_ESPTOOLPY_FLASHSIZE_4MB=y
CONFIG_PARTITION_TABLE_CUSTOM=y
```

## firmware/esp32p4-bt-bridge-rx/main/Kconfig.projbuild
```kconfig
menu "AirMix P4"

choice AIRMIX_LCD_APP
    prompt "LCD application mode"
    default AIRMIX_LCD_COLORCHECKER

config AIRMIX_LCD_COLORCHECKER
    bool "ColorChecker test pattern (no camera)"
    help
        Draw X-Rite ColorChecker Classic on ST7789 to verify RGB565 /
        BGR / endian / invert settings without the camera pipeline.

config AIRMIX_CAMERA_PREVIEW
    bool "Camera preview on SPI ST7789 (OV5647 link test)"
    help
        Live OV5647 camera on the external ST7789 SPI LCD.

config AIRMIX_BT_BRIDGE
    bool "BT audio bridge + LVGL status UI"
    help
        Default AirMix product path: I2S from ESP32-AUDIO to board speaker.

endchoice

endmenu
```

## firmware/esp32p4-bt-bridge-rx/sdkconfig.defaults
```kconfig
# Match Waveshare 02_HelloWorld + rev v1.x (verified booting on this board)
CONFIG_IDF_TARGET="esp32p4"
CONFIG_ESPTOOLPY_FLASHMODE_QIO=y
CONFIG_ESPTOOLPY_FLASHSIZE_16MB=y
CONFIG_COMPILER_OPTIMIZATION_PERF=y
CONFIG_SPIRAM=y
CONFIG_SPIRAM_SPEED_200M=y
CONFIG_SPIRAM_XIP_FROM_PSRAM=y
CONFIG_CACHE_L2_CACHE_256KB=y
CONFIG_CACHE_L2_CACHE_LINE_128B=y
CONFIG_ESP_MAIN_TASK_STACK_SIZE=10240
CONFIG_FREERTOS_HZ=1000

# Console: UART primary (GPIO 37/38 on board), USB secondary for idf_monitor
CONFIG_ESP_CONSOLE_UART_DEFAULT=y
CONFIG_ESP_CONSOLE_UART_NUM=0
CONFIG_ESP_CONSOLE_SECONDARY_USB_SERIAL_JTAG=y

CONFIG_ESP32P4_SELECTS_REV_LESS_V3=y
CONFIG_ESP32P4_REV_MIN_1=y

# ST7789V status UI (LVGL)
CONFIG_LV_FONT_MONTSERRAT_14=y
CONFIG_LV_FONT_MONTSERRAT_16=y
CONFIG_LV_FONT_MONTSERRAT_28=y

# OV5647 MIPI-CSI preview on SPI ST7789 (LCD color config: docs/esp32_p4_spi_lcd_wiring.md)
CONFIG_AIRMIX_CAMERA_PREVIEW=y
# CONFIG_AIRMIX_LCD_COLORCHECKER is not set
# CONFIG_AIRMIX_BT_BRIDGE is not set
CONFIG_EXAMPLE_MIPI_CSI_SCCB_I2C_SCL_PIN=8
CONFIG_EXAMPLE_MIPI_CSI_SCCB_I2C_SDA_PIN=7
CONFIG_CAMERA_OV5647=y
CONFIG_CAMERA_OV5647_MIPI_RAW8_800x1280_50FPS=y
CONFIG_ESP_VIDEO_ENABLE_ISP_PIPELINE_CONTROLLER=y
CONFIG_IDF_EXPERIMENTAL_FEATURES=y
```

## firmware/esp32p4-bt-bridge-rx/sdkconfig.defaults.full
```kconfig
CONFIG_IDF_TARGET="esp32p4"
CONFIG_ESPTOOLPY_FLASHMODE_QIO=y
CONFIG_ESPTOOLPY_FLASHSIZE_16MB=y
CONFIG_PARTITION_TABLE_OFFSET=0x9000
CONFIG_COMPILER_OPTIMIZATION_DEBUG=y

# Boot isolation: no PSRAM XIP / no PSRAM at all for first bring-up
CONFIG_SPIRAM=n

CONFIG_ESP_CONSOLE_USB_SERIAL_JTAG=y
CONFIG_LOG_DEFAULT_LEVEL_INFO=y

CONFIG_ESP32P4_SELECTS_REV_LESS_V3=y
CONFIG_ESP32P4_REV_MIN_1=y
```

## firmware/esp32p4-bt-bridge-rx/sdkconfig.defaults.pre_v3
```kconfig
# ESP32-P4 rev v0.x / v1.x 工程样片（你的板子 v1.3 用这个）
CONFIG_ESP32P4_SELECTS_REV_LESS_V3=y
CONFIG_ESP32P4_REV_MIN_1=y
```
